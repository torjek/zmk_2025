## boards/shields/katori/Kconfig.shield
```kconfig
config SHIELD_KATORI
    def_bool $(shields_list_contains,katori)
    select ADC
    select GPIO
```

## config/boards/shields/v4/Kconfig.shield
```kconfig
# Copyright (c) 2020 Ryan Cross
# SPDX-License-Identifier: MIT

config SHIELD_V4_LEFT
    def_bool $(shields_list_contains,v4_left)

config SHIELD_V4_RIGHT
    def_bool $(shields_list_contains,v4_right)
```

## config/boards/shields/v4_2/Kconfig.defconfig
```kconfig
# Copyright (c) 2022 The ZMK Contributors
# SPDX-License-Identifier: MIT

if SHIELD_V4_2_LEFT

config ZMK_KEYBOARD_NAME
    default "V4_2"
    
config ZMK_SPLIT_ROLE_CENTRAL
    default y

endif

if SHIELD_V4_2_LEFT || SHIELD_V4_2_RIGHT

config ZMK_SPLIT
    default y

endif
```

## config/boards/shields/v4_2/Kconfig.shield
```kconfig
# Copyright (c) 2022 The ZMK Contributors
# SPDX-License-Identifier: MIT

config SHIELD_V4_2_LEFT
    def_bool $(shields_list_contains,v4_2_left)

config SHIELD_V4_2_RIGHT
    def_bool $(shields_list_contains,v4_2_right)
```

## config/west.yml
```yaml
manifest:
  remotes:
    - name: zmkfirmware
      url-base: https://github.com/torjek
    - name: grassfedreeve
      url-base: https://github.com/grassfedreeve
    - name: aym1607
      url-base: https://github.com/AYM1607
  projects:
    - name: zmk
      remote: zmkfirmware
      revision: main
      import: app/west.yml
    - name: zmk-keyboards-katori
      remote: grassfedreeve
      revision: main
    - name: zmk-driver-azoteq-iqs5xx
      remote: aym1607
      revision: main
  self:
    path: config
```
