#include <zephyr/dt-bindings/gpio/nordic-nrf-gpio.h>
#include <zephyr/dt-bindings/dt-util.h>

&matrix {
	strobe-gpios
			= <&gpio1 15 (GPIO_ACTIVE_HIGH | NRF_GPIO_DRIVE_H0H1)>		/* D10 */
			, <&gpio1 14 (GPIO_ACTIVE_HIGH | NRF_GPIO_DRIVE_H0H1)>		/* D9 */
			, <&gpio1 13 (GPIO_ACTIVE_HIGH | NRF_GPIO_DRIVE_H0H1)>		/* D8 */
			, <&gpio1 12 (GPIO_ACTIVE_HIGH | NRF_GPIO_DRIVE_H0H1)>		/* D7 */
		/*
		= <&xiao_d 10 (GPIO_ACTIVE_HIGH)>
		, <&xiao_d 9  (GPIO_ACTIVE_HIGH)>
		, <&xiao_d 8  (GPIO_ACTIVE_HIGH)>
		, <&xiao_d 7  (GPIO_ACTIVE_HIGH)>
		*/
		;
	io-channels = <&adc 1>;
};

&adc {
        status = "okay";

    #address-cells = <1>;
    #size-cells = <0>;
    // EC Read
    channel@1 {
	reg = <1>;
        zephyr,input-positive = <NRF_SAADC_AIN0>; /* P0.02 */
        zephyr,gain = "ADC_GAIN_1_6";
        zephyr,reference = "ADC_REF_INTERNAL";
        zephyr,acquisition-time = <ADC_ACQ_TIME(ADC_ACQ_TIME_MICROSECONDS, 3)>;
        zephyr,resolution = <8>;
    };
};

&matrix {
	/*
	power-gpios = <&gpio0 9 GPIO_ACTIVE_HIGH>;
	matrix-warm-up-us = <500>;
	*/
};

&uicr {
	nfct-pins-as-gpios;
};

