/*
 * The keymap of the DA MonoTypist, generated by tools/gen-keymap.mjs from layout/da.json.
 * Do not edit this file: change layout/da.json and run "node tools/gen-keymap.mjs".
 */

#define MT_COMBOS "../v4_2_da/v4_2_da.combos.dtsi"
#define MT_LAYERS "../v4_2_da/v4_2_da.layers.dtsi"
#include "../monotypist/monotypist.keymap.dtsi"
