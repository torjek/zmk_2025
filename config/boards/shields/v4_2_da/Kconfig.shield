## config/boards/shields/v4_2_da/Kconfig.shield
```kconfig
config SHIELD_V4_2_DA_LEFT
    def_bool $(shields_list_contains,v4_2_da_left)

config SHIELD_V4_2_DA_RIGHT
    def_bool $(shields_list_contains,v4_2_da_right)
```

## config/boards/shields/v4_2_da_simple/Kconfig.defconfig
```kconfig
if SHIELD_V4_2_DA_SIMPLE_LEFT

config ZMK_KEYBOARD_NAME
    default "V4_2_DA_SIMP"
    
config ZMK_SPLIT_ROLE_CENTRAL
    default y

endif

if SHIELD_V4_2_DA_SIMPLE_LEFT || SHIELD_V4_2_DA_SIMPLE_RIGHT

config ZMK_SPLIT
    default y

endif
```

## config/boards/shields/v4_2_da_simple/Kconfig.shield
```kconfig
config SHIELD_V4_2_DA_SIMPLE_LEFT
    def_bool $(shields_list_contains,v4_2_da_simple_left)

config SHIELD_V4_2_DA_SIMPLE_RIGHT
    def_bool $(shields_list_contains,v4_2_da_simple_right)
```

## config/boards/shields/v4_2_hu/Kconfig.defconfig
```kconfig
# Copyright (c) 2022 The ZMK Contributors
# SPDX-License-Identifier: MIT

if SHIELD_V4_2_HU_LEFT

config ZMK_KEYBOARD_NAME
    default "V4_2_HU"
    
config ZMK_SPLIT_ROLE_CENTRAL
    default y

endif

if SHIELD_V4_2_HU_LEFT || SHIELD_V4_2_HU_RIGHT

config ZMK_SPLIT
    default y

endif
```

## config/boards/shields/v4_2_hu/Kconfig.shield
```kconfig
# Copyright (c) 2022 The ZMK Contributors
# SPDX-License-Identifier: MIT

config SHIELD_V4_2_HU_LEFT
    def_bool $(shields_list_contains,v4_2_hu_left)

config SHIELD_V4_2_HU_RIGHT
    def_bool $(shields_list_contains,v4_2_hu_right)
```

## config/boards/shields/v4_2_hu_simple/Kconfig.defconfig
```kconfig
if SHIELD_V4_2_HU_SIMPLE_LEFT

config ZMK_KEYBOARD_NAME
    default "V4_2_HU_SIMP"
    
config ZMK_SPLIT_ROLE_CENTRAL
    default y

endif

if SHIELD_V4_2_HU_SIMPLE_LEFT || SHIELD_V4_2_HU_SIMPLE_RIGHT

config ZMK_SPLIT
    default y

endif
```

## config/boards/shields/v4_2_hu_simple/Kconfig.shield
```kconfig
config SHIELD_V4_2_HU_SIMPLE_LEFT
    def_bool $(shields_list_contains,v4_2_hu_simple_left)

config SHIELD_V4_2_HU_SIMPLE_RIGHT
    def_bool $(shields_list_contains,v4_2_hu_simple_right)
```

## config/boards/torjek/monogreen/Kconfig.defconfig
```kconfig
# MonoGreen board configuration

# Copyright (c) 2020 Pete Johanson, Derek Schmell
# SPDX-License-Identifier: MIT

if BOARD_MONOGREEN

config BOARD
    default "monogreen"

if USB_DEVICE_STACK

config USB_NRFX
    default y

endif # USB_DEVICE_STACK

config BT_CTLR
    default BT

endif # BOARD_MONOGREEN
```

## config/boards/torjek/monogreen/Kconfig.monogreen
```kconfig
# SPDX-License-Identifier: MIT

config BOARD_MONOGREEN
    select SOC_NRF52840_QIAA
```
