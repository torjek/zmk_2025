/*
 * The keymap of the HU MonoTypist, generated by tools/gen-keymap.mjs from layout/hu.json.
 * Do not edit this file: change layout/hu.json and run "node tools/gen-keymap.mjs".
 */

#define MT_COMBOS "../v4_2_hu/v4_2_hu.combos.dtsi"
#define MT_LAYERS "../v4_2_hu/v4_2_hu.layers.dtsi"
#include "../monotypist/monotypist.keymap.dtsi"
