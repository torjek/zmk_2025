/*
 * The keymap of the US MonoTypist, generated by tools/gen-keymap.mjs from layout/us.json.
 * Do not edit this file: change layout/us.json and run "node tools/gen-keymap.mjs".
 */

#define MT_COMBOS "../v4_2_us/v4_2_us.combos.dtsi"
#define MT_LAYERS "../v4_2_us/v4_2_us.layers.dtsi"
#include "../monotypist/monotypist.keymap.dtsi"
